## arch/x86/Kconfig.fpu
```kconfig
# SPDX-License-Identifier: GPL-2.0

menuconfig USING_FPU_IN_KERNEL_NONATOMIC
	bool "Hygon large memory copy support"

if USING_FPU_IN_KERNEL_NONATOMIC

choice
	prompt "X86_HYGON_LMC"
	depends on X86_64 && CPU_SUP_HYGON
	default X86_HYGON_LMC_SSE2_ON

config X86_HYGON_LMC_SSE2_ON
	bool "Using sse2 nt copy for large memory copy"
	help
	  When this feature is enabled, we will using copy_user_sse2_nt_string
	  for lagre memory copy.

config X86_HYGON_LMC_AVX2_ON
	bool "Using avx2 nt copy for large memory copy"
	help
	  When this feature is enabled, we will using copy_user_avx2_nt_string
	  for lagre memory copy.

endchoice
endif
```

## drivers/net/ethernet/wangxun/Kconfig
```kconfig
# SPDX-License-Identifier: GPL-2.0-only
#
# Wangxun network device configuration
#

config NET_VENDOR_WANGXUN
	bool "Wangxun devices"
	default y
	help
	  If you have a network (Ethernet) card belonging to this class, say Y.

	  Note that the answer to this question doesn't directly affect the
	  kernel: saying N will just cause the configurator to skip all
	  the questions about Intel cards. If you say Y, you will be asked for
	  your specific card in the following questions.

if NET_VENDOR_WANGXUN

config TXGBE
	tristate "Wangxun(R) 10GbE PCI Express adapters support"
	depends on PCI
	imply PTP_1588_CLOCK
	help
	  This driver supports Wangxun(R) 10GbE PCI Express family of
	  adapters.

	  More specific information on configuring the driver is in
	  <file:Documentation/networking/device_drivers/ethernet/wangxun/txgbe.rst>.

	  To compile this driver as a module, choose M here. The module
	  will be called txgbe.

config NGBE
       tristate "Netswift PCI-Express Gigabit Ethernet support"
       depends on PCI
       imply PTP_1588_CLOCK
       help
         This driver supports Netswift gigabit ethernet adapters.
         For more information on how to identify your adapter, go
         to <http://www.net-swift.com>

         To compile this driver as a module, choose M here. The module
         will be called ngbe.

config TXGBEVF
       tristate "Netswift PCI-Express 10GbE Virtual Function support"
       depends on PCI
       imply PTP_1588_CLOCK
       help
         This driver supports Netswift 10gigabit ethernet adapters
         virtual functions. For more information on how to identify
         your adapter, go to <http://www.net-swift.com>

         To compile this driver as a module, choose M here. The module
         will be called txgbevf.

endif # NET_VENDOR_WANGXUN
```

## drivers/platform/mpam/Kconfig
```kconfig
# SPDX-License-Identifier: GPL-2.0-only
# Confusingly, this is everything but the CPU bits of MPAM. CPU here means
# CPU resources, not containers or cgroups etc.
config ARM_CPU_RESCTRL
	bool
	default y
	depends on ARM64 && ARCH_HAS_CPU_RESCTRL
	select RESCTRL_RMID_DEPENDS_ON_CLOSID

config ARM64_MPAM_MDEV
	tristate "MPAM MSC vfio-mdev driver"
	default n
	depends on ARM64 && ARM64_MPAM && VFIO_MDEV
```
