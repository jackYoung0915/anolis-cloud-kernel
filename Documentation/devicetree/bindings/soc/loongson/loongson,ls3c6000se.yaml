## Documentation/devicetree/bindings/soc/loongson/loongson,ls3c6000se.yaml
```yaml
# SPDX-License-Identifier: (GPL-2.0-only OR BSD-2-Clause)
%YAML 1.2
---
$id: http://devicetree.org/schemas/soc/loongson/loongson,ls3c6000se.yaml#
$schema: http://devicetree.org/meta-schemas/core.yaml#
title: Loongson Security Module (SE)
maintainers:
  - Qunqin Zhao <zhaoqunqin@loongson.cn>
description:
  This binding describes the Loongson Security Module which provides control for
  hardware encryption acceleration devices.
properties:
  compatible:
    items:
      - enum:
          - "loongson,ls3xse"
  reg:
    maxItems: 1
  interrupts:
    minItems: 1
    maxItems: 32
  dmam_size:
    $ref: /schemas/types.yaml#/definitions/uint32
required:
  - compatible
  - reg
  - interrupts
  - dmam_size
additionalProperties: false
examples:
  - |
    #include <dt-bindings/interrupt-controller/irq.h>
    soc {
      #address-cells = <2>;
      #size-cells = <2>;
      lsse@c00e0000000 {
        compatible = "loongson,ls3c6000se";
        reg = <0xc00 0xe0000000 0x0 0x1000>;
        interrupt-parent = <&liointc>;
        interrupts = <0x20 IRQ_TYPE_LEVEL_HIGH>;
        dmam_size = <0x800000>;
      };
    };
```

## drivers/crypto/sedriver/Kconfig
```kconfig
#
# se chip configuration
#

config SW_SE_CHIP
	tristate "Loongson Secure Engine Cryptographic Accelerator"
	depends on LOONGARCH
	help
	  This driver supports the Secure Engine (SE) cryptographic accelerator
	  integrated in Loongson 3A5000/3C5000 processors. It provides hardware
	  acceleration for AES, SHA-256, and RSA algorithms. Supports three
	  compilation modes: built-in, module, and disabled.
```

## drivers/gpu/drm/yhgch/Kconfig
```kconfig
    config DRM_YHGCH
    tristate "DRM Support for YHGCH"
    depends on DRM && PCI && MMU
    select DRM_KMS_HELPER
    select DRM_TTM
    help
        Choose this option if you have a YHGCH soc chipset.If M is selected the
        module will be called yhgch-drm.
```

## drivers/pinctrl/sophgo/Kconfig
```kconfig
# SPDX-License-Identifier: GPL-2.0-only
#
# Sophgo SoC PINCTRL drivers
#

config PINCTRL_SOPHGO_COMMON
	tristate
	select GENERIC_PINCTRL_GROUPS
	select GENERIC_PINMUX_FUNCTIONS
	select GENERIC_PINCONF
```

## drivers/staging/kunpeng/Kconfig
```kconfig
# SPDX-License-Identifier: GPL-2.0-only
#
# ACPI Configuration for ARM64
#

config KUNPENG_MPAM
	bool "Support Memory Partitioning and Monitoring"
	default n
	depends on ACPI
	select KUNPENG_RESCTRL
	select ACPI_MPAM if ACPI
	help
	  Memory Partitioning and Monitoring. More exactly Memory system
	  performance resource Partitioning and Monitoring
```

## drivers/staging/kunpeng/fs/Kconfig
```kconfig
# SPDX-License-Identifier: GPL-2.0-only
#

config KUNPENG_RESCTRL
	bool "Support Memory Partitioning and Monitoring"
	default n
	depends on KUNPENG_MPAM
	select KERNFS
	help
	  Memory Partitioning and Monitoring. More exactly Memory system
	  performance resource Partitioning and Monitoring
```

## drivers/virt/coco/Kconfig
```kconfig
# SPDX-License-Identifier: GPL-2.0-only
#
# Confidential computing related collateral
#

config TSM_REPORTS
	select CONFIGFS_FS
	tristate "TSP report configfs ABI support"
	help
	  TSM report configfs ABI support

source "drivers/virt/coco/efi_secret/Kconfig"

source "drivers/virt/coco/csv-guest/Kconfig"

source "drivers/virt/coco/tdx-guest/Kconfig"
```

## net/nettrace/Kconfig
```kconfig
config NET_TRACE
	tristate "Net trace"
	depends on KPROBES
	default n
	help
	  Trace net package from the kernel network proto stack.Nettrace is
	  a new kernel module for network packet capture and tracking.It can
	  capture packets from common protocol stacks and various points within
	  the kernel, detect abnormal packets, and print kernel and user-mode
	  stacks at tracepoints. It is designed to be scalable and to have
	  minimal impact on system performance.
```
